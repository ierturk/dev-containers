## Yocto/jetson-nano/conf/bblayers.conf
```bitbake
# Version of layers configuration, specific to
# each defined distro in the repository.
# Format: ${DISTRO}-<version>
TD_BBLAYERS_CONF_VERSION = "tegrademo-4"

BBPATH = "${TOPDIR}"
BBFILES ?= ""

BBLAYERS ?= " \
  /workspace/tegra-demo-distro/layers/meta \
  /workspace/tegra-demo-distro/layers/meta-tegra \
  /workspace/tegra-demo-distro/layers/meta-tegra/contrib \
  /workspace/tegra-demo-distro/layers/meta-oe \
  /workspace/tegra-demo-distro/layers/meta-python \
  /workspace/tegra-demo-distro/layers/meta-networking \
  /workspace/tegra-demo-distro/layers/meta-filesystems \
  /workspace/tegra-demo-distro/layers/meta-virtualization \
  /workspace/tegra-demo-distro/layers/meta-tegra-community \
  /workspace/tegra-demo-distro/layers/meta-tegra-support \
  /workspace/tegra-demo-distro/layers/meta-demo-ci \
  /workspace/tegra-demo-distro/layers/meta-tegrademo \
  "
```
